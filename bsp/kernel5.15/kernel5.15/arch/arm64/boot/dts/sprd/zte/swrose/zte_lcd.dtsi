/*
&panel {
	avdd-gpio = <&ap_gpio 135 GPIO_ACTIVE_HIGH>;
	avee-gpio = <&ap_gpio 136 GPIO_ACTIVE_HIGH>;
	reset-gpio = <&ap_gpio 50 GPIO_ACTIVE_HIGH>;
};*/

&i2c5 {
	ti65132b@3e {
		compatible = "tps,ti65132b";
		reg = <0x3e>;
		/*if set tps65132b_enhance_value,means bigger than this board_id*/
		zte,tps65132b_enhance_value = <0xffff>;
		zte,lcd-bl-vsp-vsn-enhance-enable;
	};
};
