&spi3 {
	status = "ok";
	#address-cells = <1>;
	#size-cells = <0>;
	/delete-node/ touchpanel@0;
	zte-ts@0 {
		compatible = "focaltech,fts", "gcore,touchscreen", "sitronix_ts";
		reg = <0>;
		spi-max-frequency = <6000000>;
		focaltech,reset-gpio = <&ap_gpio 145 0x0000>;
		focaltech,irq-gpio =  <&eic_async 16 0x2008>; /* IRQF_ONESHOT | IRQF_TRIGGER_LOW */
		focaltech,display-coords = <0 0 720 1640>;
		focaltech,max-touch-number = <10>;
		gcore,rst-gpio = <&ap_gpio 145 0x0000>;
		gcore,irq-gpio = <&eic_async 16 0x2008>;
		irq-gpio = <&eic_async 16 0x2008>;
		rst-gpio = <&ap_gpio 145 0x0000>;
	};
 };

 /{
	zte_tp:zte_tp {
		compatible = "zte_tp";
		zte,tp_algo;
		zte,tp_long_press;
		zte,tp_long_press_timer = <800>;
		zte,tp_long_press_left_v = <12>;
		zte,tp_long_press_right_v = <12>;
		zte,tp_long_press_left_h = <16>; /*camera */
		zte,tp_long_press_right_h = <12>; /*charger */
		zte,tp_edge_click_suppression_pixel = <2>;
	};
};